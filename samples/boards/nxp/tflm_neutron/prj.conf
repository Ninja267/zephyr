## CMakeLists.txt
```
# SPDX-FileCopyrightText: Copyright 2026
# SPDX-License-Identifier: Apache-2.0

cmake_minimum_required(VERSION 3.20.0)

find_package(Zephyr REQUIRED HINTS $ENV{ZEPHYR_BASE})

project(tflm_neutron)

# Add application sources (exclude model.hpp from glob)
file(GLOB app_sources src/*.c src/*.cpp src/*.h)
target_sources(app PRIVATE ${app_sources})

# Board-specific model include path
if(CONFIG_SOC_MIMXRT798S)
    target_include_directories(app PRIVATE ${CMAKE_CURRENT_SOURCE_DIR}/src/models/rt700)
elseif(CONFIG_BOARD_FRDM_MCXN947 OR CONFIG_SOC_MCXN947)
    target_include_directories(app PRIVATE ${CMAKE_CURRENT_SOURCE_DIR}/src/models/mcxn)
endif()
```

## sample.yaml
```
sample:
  description: Hello world TFLM inference with NXP Neutron NPU.
  name: NXP Neutron NPU sample
tests:
  sample.boards.nxp.tflm_neutron:
    tags:
      - NPU
    modules:
      - tflite-micro
    build_only: true
    platform_allow:
      - mimxrt700_evk/mimxrt798s/cm33_cpu0
      - mcx_n9xx_evk/mcxn947/cpu0
      - frdm_mcxn947/mcxn947/cpu0
    integration_platforms:
      - mimxrt700_evk/mimxrt798s/cm33_cpu0
      - mcx_n9xx_evk/mcxn947/cpu0
      - frdm_mcxn947/mcxn947/cpu0
```

## prj.conf
```kconfig
# SPDX-FileCopyrightText: Copyright 2024
# SPDX-License-Identifier: Apache-2.0

# C++ support with full standard library (required for TFLM STL headers)
CONFIG_CPP=y
CONFIG_STD_CPP17=y
CONFIG_REQUIRES_FULL_LIBCPP=y
CONFIG_GLIBCXX_LIBCPP=y

# TensorFlow Lite Micro
CONFIG_TENSORFLOW_LITE_MICRO=y

# NXP NEUTRON NPU support with TFLM integration
# This will select NXP_NEUTRON automatically
CONFIG_TFLM_NXP_NEUTRON=y

# Enable float printf for confidence scores
CONFIG_REQUIRES_FLOAT_PRINTF=y

# Use picolibc for embedded platforms (recommended for TFLM)
CONFIG_PICOLIBC=y
CONFIG_PICOLIBC_IO_FLOAT=y

# Enable logging (optional)
CONFIG_LOG=y

# Enable FPU for floating point operations
CONFIG_FPU=y
```

## src/main.c
```c
/*
 * Copyright 2026 NXP 
 * SPDX-License-Identifier: Apache-2.0
 *
 * MobileNet Image Classification Sample
 */

#include "main_functions.h"
#include <zephyr/kernel.h>
#include <zephyr/sys/printk.h>

/* Number of inference runs */
#define NUM_INFERENCE_RUNS 1

int main(int argc, char *argv[])
{
	printk("\n\n=== TFLM NXP Neutron Starting ===\n");

	/* Initialize the model and interpreter */
	setup();

	/* Run inference */
	for (int i = 0; i < NUM_INFERENCE_RUNS; i++) {
		loop();
		k_msleep(100);
	}

	printk("Inference complete!\n");
	return 0;
}
```

## src/image_data.h
```c
/*
 * Copyright 2026 NXP
 * SPDX-License-Identifier: Apache-2.0
 */


#define STATIC_IMAGE_NAME "ship"

// Image dimensions 32 x 32 x 3
static const uint8_t image_data[] = {
    233, 226, 236, 236, 228, 238, 235, 229, 239, 237, 230, 239, 238, 230, 240, 239, 231, 
    239, 240, 230, 238, 241, 230, 237, 241, 230, 237, 240, 228, 236, 237, 225, 233, 236, 
    224, 231, 235, 224, 233, 236, 225, 232, 235, 223, 232, 236, 227, 237, 239, 231, 240, 
    238, 232, 241, 237, 230, 240, 234, 228, 239, 234, 227, 239, 233, 227, 238, 233, 226, 
    237, 231, 224, 235, 230, 222, 234, 223, 217, 229, 220, 213, 226, 219, 214, 226, 221, 
    214, 227, 225, 219, 232, 226, 221, 235, 224, 219, 233, 225, 220, 230, 227, 221, 231, 
    228, 222, 233, 229, 223, 234, 231, 223, 234, 232, 224, 234, 235, 225, 233, 237, 226, 
    234, 237, 225, 232, 235, 224, 232, 234, 223, 231, 231, 220, 228, 231, 220, 228, 230, 
    220, 229, 229, 220, 229, 231, 223, 234, 233, 226, 237, 231, 225, 236, 233, 226, 237, 
    231, 225, 236, 227, 221, 233, 231, 224, 235, 229, 221, 233, 227, 219, 231, 227, 219, 
    231, 226, 218, 229, 223, 215, 227, 224, 216, 227, 223, 216, 228, 226, 219, 232, 224, 
    218, 232, 220, 214, 229, 220, 216, 227, 220, 215, 226, 219, 214, 226, 222, 216, 227, 
    224, 217, 227, 226, 217, 228, 227, 217, 225, 228, 218, 224, 228, 218, 224, 229, 218, 
    226, 227, 217, 225, 229, 218, 226, 229, 220, 228, 229, 219, 228, 228, 221, 230, 224, 
    213, 222, 229, 221, 231, 225, 217, 228, 223, 217, 228, 221, 215, 226, 214, 209, 219, 
    221, 214, 225, 219, 212, 224, 219, 212, 223, 221, 213, 224, 219, 211, 223, 219, 211, 
    224, 219, 211, 224, 217, 209, 223, 214, 208, 222, 211, 206, 220, 209, 204, 219, 218, 
    215, 227, 217, 214, 225, 219, 215, 227, 222, 216, 227, 222, 215, 227, 224, 216, 226, 
    227, 217, 226, 229, 218, 224, 231, 219, 225, 228, 217, 225, 229, 218, 226, 230, 219, 
    227, 231, 220, 229, 229, 219, 227, 231, 221, 230, 208, 204, 213, 229, 221, 232, 224, 
    218, 229, 225, 218, 229, 218, 213, 224, 156, 156, 166, 223, 216, 228, 222, 214, 224, 
    221, 213, 224, 219, 211, 223, 216, 209, 223, 219, 211, 225, 218, 212, 225, 215, 208, 
    223, 210, 205, 220, 207, 202, 218, 206, 201, 216, 219, 216, 228, 221, 216, 227, 221, 
    216, 227, 222, 216, 228, 222, 215, 226, 225, 217, 226, 227, 217, 225, 230, 219, 226, 
    230, 218, 226, 231, 219, 227, 231, 220, 228, 232, 220, 229, 231, 220, 229, 232, 222, 
    231, 200, 194, 199, 186, 184, 193, 230, 223, 234, 225, 219, 230, 225, 219, 231, 202, 
    200, 211, 194, 191, 201, 221, 213, 225, 222, 214, 225, 218, 211, 223, 201, 197, 208, 
    208, 203, 216, 214, 208, 223, 214, 207, 222, 213, 206, 221, 210, 205, 221, 208, 204, 
    220, 207, 204, 219, 216, 213, 225, 217, 213, 224, 218, 212, 224, 220, 214, 225, 223, 
    215, 226, 223, 215, 224, 226, 216, 224, 228, 217, 223, 231, 218, 224, 230, 219, 226, 
    229, 218, 227, 232, 220, 228, 229, 219, 227, 230, 220, 228, 191, 186, 192, 198, 194, 
    202, 215, 209, 218, 204, 201, 211, 211, 206, 216, 186, 184, 193, 201, 196, 206, 222, 
    215, 227, 217, 210, 223, 214, 209, 223, 163, 163, 174, 208, 203, 217, 209, 204, 219, 
    208, 203, 218, 207, 201, 217, 206, 201, 217, 203, 200, 216, 201, 199, 215, 214, 210, 
    223, 213, 210, 222, 216, 211, 224, 219, 213, 225, 222, 213, 224, 225, 216, 224, 227, 
    216, 223, 228, 218, 223, 228, 216, 223, 227, 216, 225, 226, 215, 224, 226, 216, 225, 
    226, 217, 226, 230, 219, 229, 191, 189, 193, 229, 221, 233, 228, 222, 233, 223, 218, 
    231, 217, 214, 225, 169, 168, 178, 202, 199, 208, 199, 195, 204, 199, 196, 206, 191, 
    188, 198, 164, 167, 175, 202, 198, 213, 200, 197, 212, 204, 200, 215, 204, 199, 215, 
    201, 198, 214, 198, 196, 213, 196, 195, 211, 211, 208, 221, 211, 208, 219, 212, 208, 
    221, 213, 209, 221, 216, 210, 222, 217, 210, 220, 220, 212, 219, 222, 213, 220, 221, 
    212, 219, 222, 213, 222, 204, 199, 205, 208, 201, 207, 207, 201, 207, 201, 196, 200, 
    104, 104, 106, 115, 113, 119, 122, 121, 127, 127, 126, 134, 120, 120, 129, 84, 89, 
    99, 142, 142, 150, 170, 167, 176, 181, 177, 187, 182, 181, 190, 161, 164, 171, 188, 
    186, 199, 197, 194, 209, 194, 192, 208, 194, 193, 209, 193, 192, 209, 189, 190, 206, 
    186, 187, 204, 209, 206, 218, 209, 206, 218, 208, 205, 218, 210, 207, 220, 211, 207, 
    219, 213, 208, 218, 214, 208, 216, 215, 209, 216, 215, 208, 216, 214, 209, 218, 217, 
    210, 220, 218, 211, 220, 217, 212, 221, 196, 192, 197, 150, 144, 140, 143, 139, 139, 
    138, 137, 137, 142, 141, 140, 109, 110, 113, 103, 102, 108, 97, 91, 94, 111, 110, 
    112, 111, 109, 113, 97, 97, 103, 94, 94, 100, 178, 178, 191, 176, 177, 190, 177, 
    178, 191, 175, 178, 193, 185, 187, 203, 179, 183, 201, 174, 180, 197, 202, 202, 215, 
    202, 202, 215, 203, 202, 216, 205, 204, 217, 205, 203, 216, 206, 204, 215, 207, 205, 
    214, 210, 206, 213, 211, 207, 215, 184, 182, 188, 195, 192, 198, 199, 195, 201, 199, 
    197, 204, 157, 151, 148, 175, 165, 162, 175, 167, 164, 180, 173, 172, 174, 168, 167, 
    139, 140, 142, 127, 125, 126, 131, 125, 123, 148, 146, 146, 161, 156, 156, 119, 121, 
    126, 139, 138, 140, 176, 179, 193, 186, 189, 205, 185, 187, 204, 181, 184, 201, 178, 
    183, 199, 173, 179, 195, 170, 176, 193, 196, 198, 211, 197, 199, 212, 197, 199, 213, 
    199, 200, 213, 199, 200, 212, 199, 199, 212, 200, 200, 208, 202, 201, 208, 201, 199, 
    207, 204, 202, 210, 203, 200, 209, 204, 202, 211, 174, 173, 177, 171, 162, 157, 192, 
    184, 186, 194, 189, 195, 200, 197, 205, 184, 184, 191, 117, 120, 123, 146, 147, 154, 
    167, 168, 174, 166, 166, 173, 158, 156, 160, 154, 150, 155, 148, 143, 146, 160, 163, 
    174, 164, 168, 182, 166, 170, 184, 161, 167, 181, 171, 178, 193, 168, 177, 193, 164, 
    173, 190, 189, 194, 207, 190, 196, 209, 190, 194, 209, 190, 194, 209, 192, 195, 208, 
    193, 195, 207, 194, 195, 205, 194, 196, 203, 197, 197, 206, 198, 198, 209, 200, 201, 
    210, 189, 191, 199, 143, 146, 149, 146, 148, 151, 155, 157, 163, 150, 155, 162, 159, 
    163, 171, 142, 147, 156, 106, 113, 119, 134, 139, 149, 158, 162, 173, 172, 175, 187, 
    159, 166, 179, 177, 172, 177, 193, 187, 193, 155, 161, 175, 176, 183, 201, 172, 180, 
    197, 167, 176, 194, 165, 174, 192, 161, 170, 188, 156, 167, 185, 185, 192, 205, 187, 
    193, 207, 188, 194, 209, 187, 192, 206, 191, 194, 207, 192, 194, 205, 184, 187, 196, 
    152, 157, 160, 148, 149, 150, 157, 158, 158, 151, 152, 153, 152, 154, 156, 176, 175, 
    179, 191, 188, 194, 184, 182, 189, 171, 173, 181, 176, 179, 187, 126, 131, 137, 111, 
    114, 120, 118, 119, 125, 123, 125, 131, 128, 129, 136, 104, 106, 114, 71, 76, 87, 
    130, 134, 142, 144, 151, 163, 175, 184, 201, 171, 182, 200, 168, 179, 197, 161, 172, 
    189, 157, 168, 186, 154, 165, 185, 180, 188, 201, 182, 190, 205, 184, 190, 205, 186, 
    191, 207, 186, 191, 204, 187, 190, 202, 185, 189, 199, 186, 186, 191, 195, 191, 197, 
    192, 189, 194, 185, 184, 188, 183, 181, 185, 197, 191, 196, 201, 196, 201, 198, 194, 
    202, 191, 188, 197, 187, 188, 198, 127, 131, 135, 151, 149, 149, 146, 145, 145, 123, 
    122, 123, 135, 133, 133, 93, 93, 99, 100, 101, 107, 79, 75, 83, 105, 104, 109, 107, 
    106, 111, 122, 120, 126, 124, 125, 134, 156, 164, 180, 163, 172, 189, 156, 165, 184, 
    176, 187, 200, 179, 188, 201, 181, 188, 204, 183, 189, 204, 183, 189, 202, 183, 190, 
    202, 185, 188, 197, 215, 208, 212, 207, 200, 205, 209, 203, 208, 179, 177, 179, 186, 
    182, 185, 194, 189, 195, 187, 184, 188, 183, 181, 186, 188, 188, 196, 164, 167, 173, 
    141, 141, 142, 172, 168, 168, 176, 171, 172, 164, 162, 163, 157, 155, 156, 128, 130, 
    135, 110, 109, 113, 120, 120, 124, 147, 146, 150, 135, 134, 138, 161, 158, 162, 165, 
    162, 169, 162, 171, 189, 161, 169, 188, 154, 164, 183, 182, 190, 204, 182, 189, 203, 
    182, 189, 205, 184, 190, 205, 184, 190, 204, 181, 186, 197, 141, 144, 148, 128, 128, 
    134, 139, 141, 146, 153, 157, 164, 116, 114, 109, 95, 93, 91, 100, 97, 94, 95, 91, 
    91, 110, 107, 107, 119, 116, 118, 100, 101, 107, 156, 152, 152, 159, 155, 157, 140, 
    137, 139, 130, 126, 129, 118, 116, 120, 147, 146, 150, 103, 102, 108, 134, 134, 138, 
    156, 143, 150, 150, 138, 146, 168, 164, 169, 158, 155, 161, 165, 174, 190, 165, 172, 
    190, 158, 167, 185, 191, 195, 209, 192, 196, 209, 191, 196, 210, 191, 195, 208, 187, 
    192, 205, 194, 197, 209, 152, 156, 159, 104, 106, 100, 105, 106, 103, 100, 102, 100, 
    100, 102, 100, 154, 147, 140, 165, 157, 151, 150, 144, 140, 150, 146, 143, 139, 136, 
    132, 119, 120, 122, 130, 131, 134, 118, 121, 126, 126, 127, 132, 124, 126, 130, 94, 
    96, 103, 113, 115, 122, 86, 86, 95, 96, 96, 105, 119, 121, 130, 157, 155, 165, 158, 
    155, 164, 138, 134, 140, 161, 168, 183, 170, 176, 193, 164, 170, 188, 197, 199, 211, 
    198, 200, 213, 201, 201, 214, 199, 200, 213, 199, 198, 209, 204, 204, 215, 145, 147, 
    144, 149, 146, 140, 151, 148, 144, 137, 136, 131, 131, 130, 124, 178, 167, 159, 171, 
    162, 155, 168, 160, 155, 161, 153, 149, 139, 137, 136, 158, 157, 160, 183, 182, 187, 
    176, 175, 180, 165, 165, 169, 149, 151, 155, 114, 119, 125, 139, 143, 149, 110, 112, 
    119, 134, 136, 141, 141, 142, 148, 143, 142, 148, 137, 136, 143, 140, 138, 147, 191, 
    188, 203, 185, 184, 199, 177, 179, 194, 203, 202, 214, 204, 204, 217, 203, 203, 216, 
    204, 204, 216, 207, 205, 215, 185, 183, 187, 158, 156, 156, 194, 192, 194, 122, 116, 
    106, 110, 108, 104, 125, 124, 122, 121, 120, 122, 121, 122, 124, 181, 178, 180, 165, 
    163, 166, 111, 115, 120, 170, 167, 169, 174, 171, 175, 162, 158, 162, 182, 178, 183, 
    138, 138, 144, 119, 123, 130, 103, 106, 114, 139, 139, 144, 156, 156, 161, 152, 151, 
    158, 163, 161, 167, 170, 167, 175, 172, 169, 179, 193, 190, 205, 188, 186, 200, 183, 
    181, 195, 199, 202, 215, 199, 203, 217, 202, 203, 217, 201, 203, 215, 203, 203, 214, 
    200, 200, 208, 179, 182, 186, 118, 121, 123, 103, 105, 103, 105, 107, 108, 92, 94, 
    97, 91, 94, 97, 75, 80, 87, 134, 136, 141, 119, 122, 126, 103, 106, 112, 113, 116, 
    124, 106, 108, 115, 148, 151, 156, 106, 109, 117, 83, 84, 92, 86, 90, 100, 59, 62, 
    75, 137, 138, 146, 138, 138, 143, 162, 161, 172, 187, 183, 193, 180, 174, 184, 172, 
    167, 176, 193, 191, 206, 187, 186, 201, 183, 182, 197, 199, 202, 214, 200, 203, 216, 
    202, 204, 218, 204, 203, 216, 203, 203, 214, 206, 205, 214, 174, 176, 179, 125, 122, 
    114, 128, 129, 124, 111, 111, 107, 97, 97, 99, 114, 116, 117, 179, 181, 185, 139, 
    144, 148, 95, 98, 105, 114, 120, 128, 126, 132, 139, 130, 132, 139, 90, 94, 104, 
    81, 79, 86, 83, 83, 91, 93, 96, 105, 77, 80, 87, 155, 156, 168, 182, 184, 194, 135, 
    139, 150, 176, 175, 187, 188, 185, 197, 178, 175, 187, 190, 188, 202, 187, 185, 200, 
    183, 182, 197, 197, 201, 213, 200, 204, 216, 201, 204, 216, 202, 203, 216, 200, 199, 
    210, 179, 181, 187, 149, 149, 145, 148, 148, 144, 127, 126, 119, 89, 91, 93, 168, 
    166, 162, 140, 143, 143, 198, 198, 204, 124, 126, 129, 104, 109, 117, 143, 146, 153, 
    119, 124, 132, 188, 188, 196, 113, 114, 118, 76, 75, 83, 139, 138, 140, 89, 93, 102, 
    129, 131, 142, 113, 121, 132, 190, 191, 203, 166, 169, 181, 196, 194, 209, 191, 190, 
    205, 196, 194, 210, 190, 188, 203, 187, 186, 201, 182, 182, 197, 183, 192, 205, 184, 
    194, 207, 186, 193, 208, 187, 193, 207, 187, 194, 206, 164, 166, 168, 131, 130, 140, 
    164, 170, 171, 120, 123, 123, 142, 145, 149, 166, 173, 177, 155, 157, 157, 159, 163, 
    167, 89, 95, 102, 124, 116, 122, 166, 161, 165, 148, 144, 149, 132, 128, 135, 95, 
    97, 104, 132, 134, 141, 157, 164, 173, 137, 142, 151, 195, 197, 208, 121, 129, 138, 
    157, 161, 173, 144, 154, 168, 179, 181, 196, 177, 179, 194, 158, 161, 176, 174, 179, 
    196, 168, 173, 191, 163, 169, 186, 129, 150, 161, 136, 156, 167, 131, 150, 163, 131, 
    150, 162, 138, 156, 167, 107, 114, 115, 115, 112, 113, 66, 69, 79, 114, 114, 116, 
    164, 160, 159, 133, 136, 138, 80, 82, 88, 91, 100, 109, 76, 80, 89, 109, 114, 121, 
    88, 93, 102, 105, 107, 114, 100, 103, 112, 81, 83, 94, 64, 61, 72, 41, 32, 45, 26, 
    27, 40, 122, 116, 126, 120, 120, 129, 119, 113, 123, 120, 122, 132, 126, 129, 142, 
    104, 102, 116, 115, 113, 126, 105, 119, 139, 112, 127, 147, 108, 122, 143, 121, 140, 
    151, 125, 143, 154, 127, 145, 157, 126, 143, 153, 135, 148, 158, 143, 155, 161, 141, 
    142, 144, 137, 137, 134, 95, 94, 97, 137, 137, 139, 88, 88, 92, 130, 131, 132, 90, 
    89, 93, 180, 174, 177, 156, 150, 157, 145, 142, 150, 141, 144, 152, 119, 122, 132, 
    175, 175, 182, 181, 180, 187, 157, 149, 157, 177, 174, 179, 150, 154, 164, 87, 94, 
    104, 96, 104, 117, 96, 104, 116, 99, 103, 116, 130, 134, 148, 109, 116, 131, 109, 
    121, 139, 102, 115, 135, 106, 119, 139, 112, 130, 141, 116, 134, 145, 131, 148, 159, 
    132, 148, 158, 115, 131, 140, 125, 141, 150, 188, 189, 194, 221, 215, 220, 226, 217, 
    220, 218, 206, 209, 190, 182, 185, 213, 203, 206, 212, 204, 208, 240, 228, 236, 234, 
    225, 233, 215, 211, 220, 194, 194, 204, 185, 188, 197, 171, 174, 185, 145, 147, 155, 
    134, 140, 148, 92, 101, 113, 68, 75, 89, 72, 79, 94, 66, 71, 85, 80, 87, 101, 97, 
    102, 117, 118, 129, 147, 104, 116, 135, 99, 112, 130, 103, 115, 135, 90, 103, 124, 
    122, 140, 149, 131, 148, 158, 120, 135, 146, 113, 129, 140, 115, 132, 140, 88, 101, 
    111, 125, 133, 140, 207, 204, 209, 225, 217, 222, 222, 214, 218, 236, 225, 228, 239, 
    228, 233, 234, 224, 229, 222, 214, 220, 209, 206, 214, 194, 194, 201, 166, 171, 179, 
    143, 151, 160, 117, 128, 138, 91, 100, 114, 66, 76, 91, 58, 66, 82, 60, 67, 84, 60, 
    68, 83, 49, 56, 73, 55, 63, 79, 102, 114, 133, 107, 119, 138, 103, 116, 135, 112, 
    125, 143, 96, 109, 129, 95, 107, 127, 150, 162, 173, 130, 144, 155, 130, 145, 156, 
    128, 141, 150, 125, 137, 147, 127, 138, 146, 95, 108, 116, 71, 83, 90, 80, 92, 97, 
    105, 116, 121, 93, 103, 109, 75, 81, 92, 76, 79, 84, 91, 95, 97, 75, 79, 86, 69, 
    73, 82, 59, 63, 72, 48, 49, 59, 51, 53, 64, 51, 53, 65, 51, 54, 66, 62, 65, 77, 99, 
    102, 111, 66, 73, 86, 65, 73, 89, 111, 124, 140, 111, 123, 141, 113, 124, 143, 115, 
    126, 145, 121, 132, 152, 116, 130, 150, 124, 135, 156, 100, 119, 130, 128, 145, 157, 
    103, 122, 134, 107, 124, 135, 102, 118, 128, 118, 132, 142, 103, 118, 127, 117, 131, 
    139, 115, 130, 138, 101, 115, 124, 100, 113, 122, 102, 116, 126, 102, 116, 127, 97, 
    111, 122, 87, 101, 115, 80, 92, 106, 91, 104, 118, 91, 103, 118, 87, 100, 116, 84, 
    95, 110, 78, 90, 105, 76, 87, 103, 77, 88, 105, 76, 87, 104, 73, 84, 102, 72, 82, 
    100, 83, 95, 114, 86, 97, 117, 92, 105, 124, 96, 110, 129, 95, 108, 129, 95, 108, 
    129, 109, 128, 140, 112, 131, 143, 128, 146, 159, 121, 138, 149, 130, 144, 155, 121, 
    135, 145, 111, 127, 135, 110, 124, 133, 113, 127, 138, 100, 116, 125, 105, 121, 130, 
    107, 122, 132, 107, 122, 132, 115, 129, 139, 116, 130, 142, 120, 135, 148, 110, 125, 
    139, 111, 127, 142, 118, 133, 148, 104, 120, 135, 111, 127, 141, 109, 123, 138, 108, 
    124, 140, 103, 118, 134, 88, 104, 121, 88, 102, 120, 94, 108, 127, 91, 104, 124, 
    97, 109, 130, 104, 117, 137, 108, 121, 142, 115, 127, 148, 106, 125, 140, 100, 120, 
    133, 90, 107, 121, 97, 114, 128, 91, 107, 119, 97, 111, 123, 103, 118, 128, 116, 
    130, 141, 115, 129, 139, 110, 126, 136, 112, 128, 138, 107, 123, 134, 109, 124, 135, 
    112, 126, 138, 109, 122, 135, 91, 104, 118, 108, 123, 137, 112, 127, 142, 105, 121, 
    137, 104, 120, 136, 101, 118, 133, 99, 115, 130, 97, 113, 129, 102, 117, 134, 104, 
    118, 136, 107, 122, 139, 97, 111, 130, 100, 114, 133, 92, 106, 127, 95, 108, 129, 
    94, 108, 131, 97, 110, 132, 106, 125, 138, 102, 120, 134, 104, 123, 137, 108, 126, 
    140, 108, 124, 136, 110, 125, 138, 118, 133, 144, 111, 126, 137, 116, 131, 142, 113, 
    129, 139, 113, 128, 138, 112, 127, 138, 108, 123, 135, 103, 119, 131, 109, 125, 139, 
    112, 128, 141, 98, 114, 128, 92, 107, 122, 101, 117, 133, 100, 116, 132, 114, 131, 
    146, 112, 128, 143, 106, 122, 139, 111, 127, 143, 110, 127, 144, 105, 120, 138, 107, 
    121, 141, 104, 118, 138, 105, 120, 140, 101, 115, 136, 98, 113, 135, 101, 115, 138
};
static const unsigned int image_data_len = 3072;
```

## src/labels.h
```c
/*
 * Copyright 2026 NXP
 * SPDX-License-Identifier: Apache-2.0
 */


#ifndef _LABELS_H_
#define _LABELS_H_

static const char* const labels[] = {
    "airplane",
    "automobile",
    "bird",
    "cat",
    "deer",
    "dog",
    "frog",
    "horse",
    "ship",
    "truck"
};

#endif // _LABELS_H_
```

## src/main_functions.cpp
```c
/*
 * Copyright 2026 NXP 
 * All rights reserved.
 * SPDX-License-Identifier: Apache-2.0
 *
 * Image classification sample using TensorFlow Lite Micro
 * Based on MobileNet model with NPU (Neutron) acceleration
 */

#include "main_functions.h"
#include "model.hpp"
/* Include image data and labels */
#include "image_data.h"
#include "labels.h"

/* TensorFlow Lite Micro headers */
#include <tensorflow/lite/micro/micro_interpreter.h>
#include <tensorflow/lite/micro/micro_mutable_op_resolver.h>
#include <tensorflow/lite/micro/kernels/micro_ops.h>
#include <tensorflow/lite/schema/schema_generated.h>
#include "tensorflow/lite/micro/kernels/neutron/neutron.h"

#include <zephyr/sys/printk.h>
#include <zephyr/linker/section_tags.h>
#include <zephyr/autoconf.h>
#include <zephyr/cache.h>

/* Number of top results to display */
#define TOP_K_RESULTS 5
#define LABEL_COUNT 10

#ifdef __arm__
#include <cmsis_compiler.h>
#else
#define __ALIGNED(x) __attribute__((aligned(x)))
#endif


/* Tensor arena size */
constexpr int kTensorArenaSize = 60 * 1024;
#if defined(CONFIG_BOARD_MIMXRT700_EVK) || defined(CONFIG_SOC_MIMXRT798S)
static uint8_t __nocache __ALIGNED(16) tensor_arena[kTensorArenaSize];
#else
static __attribute__((aligned(16))) uint8_t tensor_arena[kTensorArenaSize];
#endif

/* Globals */
static tflite::MicroInterpreter *interpreter = nullptr;
static TfLiteTensor *input = nullptr;
static TfLiteTensor *output = nullptr;

void setup(void)
{
    /* Step 1: Load model */
    const tflite::Model *model = tflite::GetModel(g_model);
    if (model->version() != TFLITE_SCHEMA_VERSION) {
        return;
    }

    /* Step 2: Create op resolver with NPU support */
    static tflite::MicroMutableOpResolver<5> resolver;
    resolver.AddDequantize();
    resolver.AddReshape();
    resolver.AddSlice();
    resolver.AddSoftmax();
    resolver.AddCustom(tflite::GetString_NEUTRON_GRAPH(),
                       tflite::Register_NEUTRON_GRAPH());

    /* Step 3: Create interpreter */
    static tflite::MicroInterpreter static_interpreter(
        model, resolver, tensor_arena, kTensorArenaSize);
    interpreter = &static_interpreter;

    /* Step 4: Allocate tensors */
    TfLiteStatus allocate_status = interpreter->AllocateTensors();
    if (allocate_status != kTfLiteOk) {
        interpreter = nullptr;
        return;
    }

    /* Step 5: Get input/output tensors */
    input = interpreter->input(0);
    output = interpreter->output(0);

    if (input == nullptr || output == nullptr) {
        return;
    }
}

void loop(void)
{
    static int inference_count = 0;

    if (interpreter == nullptr || input == nullptr || output == nullptr) {
        printk("Model not initialized. Cannot run inference.\n");
        return;
    }

    printk("Inference #%d\n", ++inference_count);
    printk("----------------------------------------\n");

    /* Copy input data */
    int input_size = 1;
    for (int i = 0; i < input->dims->size; i++) {
        input_size *= input->dims->data[i];
    }
    int output_size = 1;
    for (int i = 0; i < output->dims->size; i++) {
        output_size *= output->dims->data[i];
    }

    /* Copy input data */
    int copy_size = (input_size < (int)sizeof(image_data)) ?
                    input_size : (int)sizeof(image_data);

    if (input->type == kTfLiteInt8) {
        for (int i = 0; i < copy_size; i++) {
            input->data.int8[i] = (int8_t)(image_data[i] - 128);
        }
    } else if (input->type == kTfLiteUInt8) {
        for (int i = 0; i < copy_size; i++) {
            input->data.uint8[i] = image_data[i];
        }
    } else if (input->type == kTfLiteFloat32) {
        for (int i = 0; i < copy_size; i++) {
            input->data.f[i] = (image_data[i] - 127.5f) / 127.5f;
        }
    } else {
        printk("Unknown input tensor data type: %d", input->type);
        return;
    }

    /* Run inference */
    printk("Running inference...\n");
    TfLiteStatus status = interpreter->Invoke();
    if (status != kTfLiteOk) {
        printk("ERROR: Invoke failed with status %d\n", status);
        return;
    }
    printk("Inference complete\n");

    /* Convert output to float */
    float *scores = new float[output_size];
    if (output->type == kTfLiteFloat32) {
        for (int i = 0; i < output_size; i++) {
            scores[i] = output->data.f[i];
        }
    } else if (output->type == kTfLiteInt8) {
        float scale = output->params.scale;
        int zp = output->params.zero_point;
        for (int i = 0; i < output_size; i++) {
            scores[i] = (output->data.int8[i] - zp) * scale;
        }
    } else if (output->type == kTfLiteUInt8) {
        float scale = output->params.scale;
        int zp = output->params.zero_point;
        for (int i = 0; i < output_size; i++) {
            scores[i] = (output->data.uint8[i] - zp) * scale;
        }
    }

    /* Find top-k */
    int *indices = new int[output_size];
    for (int i = 0; i < output_size; i++) indices[i] = i;

    for (int i = 0; i < TOP_K_RESULTS && i < output_size; i++) {
        int max_idx = i;
        for (int j = i + 1; j < output_size; j++) {
            if (scores[indices[j]] > scores[indices[max_idx]]) {
                max_idx = j;
            }
        }
        int tmp = indices[i];
        indices[i] = indices[max_idx];
        indices[max_idx] = tmp;
    }

    /* Print results */
    printk("\nTop %d Results:\n", TOP_K_RESULTS);
    printk("----------------------------------------\n");
    for (int i = 0; i < TOP_K_RESULTS; i++) {
        int idx = indices[i];
        const char *label = (idx >= 0 && idx < LABEL_COUNT) ? labels[idx] : "?";
        printk("%d. %-30s %.2f%%\n", i + 1, label, (double)(scores[idx] * 100.0f));
    }
    printk("----------------------------------------\n\n");

    delete[] scores;
    delete[] indices;
}
```

## src/main_functions.h
```c
/*
 * Copyright 2026 NXP
 * SPDX-License-Identifier: Apache-2.0
 */


#ifndef TFLM_CUSTOM_MODEL_MAIN_FUNCTIONS_H_
#define TFLM_CUSTOM_MODEL_MAIN_FUNCTIONS_H_

#ifdef __cplusplus
extern "C" {
#endif

/**
 * @brief Initialize the TensorFlow Lite Micro model and interpreter.
 *
 * This function sets up the model, creates the interpreter, and allocates
 * the tensor arena. Must be called once before calling loop().
 */
void setup(void);

/**
 * @brief Run one inference cycle.
 *
 * This function performs one complete inference cycle:
 * - Copies image data to input tensor
 * - Invokes the model
 * - Prints the top classification results with labels and confidence scores
 *
 * Should be called repeatedly from the application code.
 */
void loop(void);

#ifdef __cplusplus
}
#endif

#endif /* TFLM_CUSTOM_MODEL_MAIN_FUNCTIONS_H_ */
```
