## drivers/clock_monitor/Kconfig.nxp_cmu_fc
```kconfig
# Copyright (c) 2026 NXP
# SPDX-License-Identifier: Apache-2.0

config CLOCK_MONITOR_NXP_CMU_FC
	bool "NXP CMU_FC frequency check driver"
	default y
	depends on DT_HAS_NXP_CMU_FC_ENABLED
	select HAS_MCUX
	help
	  Zephyr clock_monitor back-end wrapping the MCUX SDK fsl_cmu_fc HAL.
	  Provides WINDOW modes for clock frequency check.
```

## dts/bindings/video/nxp,imx-mipi-csi.yaml
```yaml
# Copyright 2026 NXP
# SPDX-License-Identifier: Apache-2.0

title: NXP i.MX MIPI CSI-2 Host Controller

description: |
  This binding describes the NXP i.MX MIPI CSI-2 receiver controller.

  The CSI-2 receiver is used to capture video streams from an upstream
  CSI-2 compliant source such as a camera sensor or a test generator.

  It is integrated into the video pipeline using the devicetree graph
  bindings (ports and endpoints).

  Users must define input and output ports and connect them to the
  corresponding video components.

compatible: "nxp,imx-mipi-csi"

include: [base.yaml]

properties:
  reg:
    required: true

  phys:
    type: phandle
    required: true
    description: PHY device phandle

child-binding:
  child-binding:
    child-binding:
      include: video-interfaces.yaml

examples:
  - |
    mipi_dphy: dphy@12340000 {
        compatible = "nxp,imx-mipi-dphy";
        reg = <0x12340000 0x1000>;
        status = "okay";
    };

    mipi_csi: csi@12350000 {
        compatible = "nxp,imx-mipi-csi";
        reg = <0x12350000 0x10000>;
        phys = <&mipi_dphy>;
        status = "okay";

        ports {
            #address-cells = <1>;
            #size-cells = <0>;

            port@0 {
                reg = <0>;

                csi_in: endpoint {
                    remote-endpoint = <&gen_ep_out>;
                    bus-type = <VIDEO_BUS_TYPE_CSI2_DPHY>;
                    data-lanes = <1 2 3 4>;
                };
            };
        };
    };

    video_gen: video {
        compatible = "vnd,video-single-port";
        status = "okay";

        port {
            gen_ep_out: endpoint {
                remote-endpoint = <&csi_in>;
            };
        };
    };
```

## subsys/mp/core/Kconfig
```kconfig
#
# Copyright 2025 NXP
#
# SPDX-License-Identifier: Apache-2.0
#

config MP_THREADS_NUM
	int "Maximum number of threads"
	range 0 255
	default 3

config MP_THREAD_STACK_SIZE
	int "Stack size of a thread"
	default 1024

config MP_THREAD_DEFAULT_PRIORITY
	int "Priority of a thread"
	default 5

config MP_QUEUE
	bool "Queue element (pipeline-level threading)"
	help
	  Enable the queue element which decouples pipeline segments
	  into separate threads for parallel processing. The queue
	  deposits buffers into a FIFO and spawns a dedicated thread
	  to drive the downstream segment.

config MP_WORKQUEUE
	bool "Element-level work offload (P4WQ)"
	select SCHED_DEADLINE
	help
	  Enable element-level work offloading via a shared P4WQ
	  (Pooled Parallel Preemptible Priority-based Work Queue)
	  thread pool. Elements can submit finite work items (e.g.,
	  decode, inference) to be processed on pool threads with
	  configurable priority.

config MP_WORKQUEUE_THREADS_NUM
	int "Number of threads in MP workqueue pool"
	default 1
	depends on MP_WORKQUEUE
	help
	  Number of threads in the shared P4WQ pool used for
	  element-level work offload.

config MP_WORKQUEUE_STACK_SIZE
	int "Stack size for MP workqueue pool threads"
	default 4096
	depends on MP_WORKQUEUE
	help
	  Stack size in bytes for each thread in the MP workqueue pool.

config MP_CAPSFILTER
	bool "Capsfilter support"

config MP_NET_BUF_POOL_COUNT
	int "Number of buffers can be handled at the same time for the whole pipeline"
	default 1

config MP_VALUE_POOL_SIZE
	int "Maximum number of mp_value objects"
	default 128
	help
	  Capacity of the static pool used to allocate mp_value instances.
	  mp_value is a fixed-size tagged union; this option bounds the
	  total number of values (including list items and structure fields)
	  that can be live at the same time across the whole pipeline.

config MP_STRUCTURE_POOL_SIZE
	int "Maximum number of mp_structure objects"
	default 16
	help
	  Capacity of the static pool used to allocate mp_structure
	  instances. Each set of capability fields (e.g. one media format
	  inside a caps) consumes one slot.

config MP_CAPS_POOL_SIZE
	int "Maximum number of mp_caps objects"
	default 16
	help
	  Capacity of the static pool used to allocate mp_caps instances.
	  Each pad's caps reference, query, and intermediate intersect
	  result consumes one slot.
```

## subsys/usb/host/class/Kconfig.cdc_ecm
```kconfig
# SPDX-FileCopyrightText: Copyright (c) 2025 - 2026 NXP
# SPDX-License-Identifier: Apache-2.0

config USBH_CDC_ECM_CLASS
	bool "USB Communication Device Class - Ethernet Control Mode (CDC-ECM) support [EXPERIMENTAL]"
	select EXPERIMENTAL
	select NET_L2_ETHERNET
	help
	  USB Host Communication Device Class - Ethernet Control Mode (CDC-ECM)
	  implementation. This allows using USB ECM devices (such as USB Ethernet
	  adapters) as network interfaces.

if USBH_CDC_ECM_CLASS

config USBH_CDC_ECM_ETH_DRV_NAME
	string "Ethernet interface name prefix"
	default "zeth"
	help
	  This option sets the driver name and name of the network interface
	  in your host system. If there are multiple network interfaces defined,
	  then this value is used as a prefix and use "(usbh_cdc_ecm)" as suffix
	  and the interface names will be "zeth0 (usbh_cdc_ecm)",
	  "zeth1 (usbh_cdc_ecm)", etc.

config USBH_CDC_ECM_MAX_SEGMENT_SIZE
	int "Maximum Ethernet frame size"
	default 1514
	help
	  Maximum Ethernet frame size excluding FCS.
	  - 60: Minimum frame
	  - 1514: Standard Ethernet (MTU 1500)

	  Actual size negotiated via wMaxSegmentSize in ECM descriptor.
	  FCS is handled by USB device, not included in transfers.

config USBH_CDC_ECM_MAX_LANGS
	int "Maximum language IDs to query"
	default 4
	range 1 16
	help
	  Buffer size for USB language IDs when retrieving MAC address.
	  Driver tries default LANGID first, then queries alternatives.
	  Most devices support 1-2 languages, default 4 is sufficient.

config USBH_CDC_ECM_DEFAULT_MAC_ADDR_UNICODE_LANGID
	hex "Default language ID for MAC address"
	default 0x0409
	help
	  USB LANGID for MAC address string descriptor.
	  Falls back to device-supported languages if unsupported.

	  Common: 0x0409 (English US), 0x0804 (Chinese Simplified).

config USBH_CDC_ECM_MAX_MULTICAST_FILTERS
	int "Maximum number of multicast filters"
	default 32
	range 4 256
	help
	  Maximum multicast MAC addresses tracked per CDC-ECM instance.
	  Sent to USB device via SET_ETHERNET_MULTICAST_FILTERS request.

	  Memory per instance: N * 6 bytes
	  - 32 filters: 192 bytes
	  - 64 filters: 384 bytes
	  - 128 filters: 768 bytes

	  Actual filters sent to device limited by wNumberMCFilters in
	  ECM functional descriptor. Most devices support 16-64 filters.

config USBH_CDC_ECM_TX_PIPELINE_DEPTH
	int "TX pipeline depth"
	default 1
	help
	  Concurrent bulk OUT transfers. Higher values improve throughput
	  at the cost of memory.

config USBH_CDC_ECM_RX_PIPELINE_DEPTH
	int "RX pipeline depth"
	default 1
	help
	  Concurrent bulk IN transfers. Higher values reduce packet loss
	  at the cost of memory.

module = USBH_CDC_ECM
module-str = "usbh cdc_ecm"
default-count = 1
source "subsys/logging/Kconfig.template.log_config"
source "subsys/usb/common/Kconfig.template.instances_count"

endif # USBH_CDC_ECM_CLASS
```

## tests/subsys/mp/core/testcase.yaml
```yaml
# Copyright 2025-2026 NXP
# SPDX-License-Identifier: Apache-2.0

tests:
  mp.core.value_structure_caps:
    tags:
      - mp
    platform_allow:
      - native_sim
      - native_sim/native/64
      - qemu_cortex_m3
    integration_platforms:
      - native_sim
```
